VERSION ""

NS_ :

BS_:

BU_: EPS

BO_ 123 WheelSpeed: 8 EPS
 SG_ WheelSpeedFR : 7|16@1+ (0.041667,0) [0|2730.583333] "rpm"  EPS

CM_ SG_ 123 WheelSpeedFR "Front right wheel speed";

BA_DEF_  "GenSigStartValue" FLOAT 0 1000000000;
BA_ "GenSigStartValue" SG_ 123 WheelSpeedFR 0;

VAL_ 123 WheelSpeedFR 0 "Zero" 2730.583333 "Max";
