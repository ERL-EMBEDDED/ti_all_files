VERSION ""
NS_ :

BS_:

BU_: ECU1 ECU2

BO_ 100 ExampleMessage1: 8 ECU1
 SG_ Signal1 : 0|8@1+ (1,0) [0|255] "units" ECU1
 SG_ Signal2 : 8|8@1- (1,0) [0|100] "%" ECU1

BO_ 200 ExampleMessage2: 8 ECU2
 SG_ Signal3 : 16|16@1+ (0.1,0) [0|1000] "km/h" ECU2
 SG_ Signal4 : 32|32@1- (0.01,0) [-500|500] "m/s2" ECU2

CM_ BO_ 100 "This is a comment for ExampleMessage1";
CM_ SG_ 100 Signal1 "This is a comment for Signal1";
